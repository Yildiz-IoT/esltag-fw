## nrf-esl-bluetooth/samples/peripheral_esl/boards/arm/mytag_nRF52840/Kconfig.board
```kconfig
# Copyright (c) 2023 Nordic Semiconductor ASA
# SPDX-License-Identifier: Apache-2.0

config BOARD_MYTAG_nRF52840
	bool "MYTAG_nRF52840"
	depends on SOC_NRF52840_QIAA
```

## nrf-esl-bluetooth/samples/peripheral_esl/boards/arm/mytag_nRF52840/Kconfig.defconfig
```kconfig
# Copyright (c) 2023 Nordic Semiconductor ASA
# SPDX-License-Identifier: Apache-2.0

if BOARD_MYTAG_nRF52840

config BOARD
	default "MYTAG_nRF52840"

config BT_CTLR
	default BT

endif
```
